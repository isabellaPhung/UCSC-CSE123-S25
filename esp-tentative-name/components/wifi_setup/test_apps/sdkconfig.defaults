## esp-tentative-name/components/wifi_setup/test_apps/sdkconfig.defaults
```kconfig
CONFIG_HTTPD_MAX_REQ_HDR_LEN=1024
CONFIG_LWIP_MAX_SOCKETS=16
CONFIG_ESP_HTTPS_SERVER_ENABLE=y
```

## esp-tentative-name/sdkconfig.defaults
```kconfig
# Copyright [yyyy] [name of copyright owner]
#
# Licensed under the Apache License, Version 2.0 (the "License");
# you may not use this file except in compliance with the License.
# You may obtain a copy of the License at
#
# http://www.apache.org/licenses/LICENSE-2.0
#
# Unless required by applicable law or agreed to in writing, software
# distributed under the License is distributed on an "AS IS" BASIS,
# WITHOUT WARRANTIES OR CONDITIONS OF ANY KIND, either express or implied.
# See the License for the specific language governing permissions and
# limitations under the License.

# the first line is intentional.
# the repo owner has not fixed this issue in their LICENSE file either,
# and this file did not have a copyright notice.

# original from https://github.com/espressif/esp-aws-iot/blob/master/examples/mqtt/tls_mutual_auth/sdkconfig.defaults

# newlib for ESP32 and ESP8266 platform

CONFIG_NEWLIB_ENABLE=y
CONFIG_NEWLIB_LIBRARY_LEVEL_NORMAL=y
CONFIG_NEWLIB_NANO_FORMAT=
CONFIG_SSL_USING_MBEDTLS=y
CONFIG_LWIP_IPV6=y
CONFIG_PARTITION_TABLE_CUSTOM=y
CONFIG_PARTITION_TABLE_CUSTOM_FILENAME="partitions.csv"
CONFIG_PARTITION_TABLE_FILENAME="partitions.csv"

CONFIG_ESPTOOLPY_FLASHSIZE_4MB=y
CONFIG_ESP_MAIN_TASK_STACK_SIZE=45536
CONFIG_BOOTLOADER_COMPILER_OPTIMIZATION_SIZE=y

#LVGL CONFIG
CONFIG_LV_FONT_MONTSERRAT_14=y
CONFIG_LV_FONT_MONTSERRAT_18=y
CONFIG_LV_FONT_MONTSERRAT_24=y
CONFIG_LV_USE_GRIDNAV=y
CONFIG_LV_BUILD_EXAMPLES=n

CONFIG_LV_WIDGETS_HAS_DEFAULT_VALUE=y
CONFIG_LV_USE_ANIMIMG=n
CONFIG_LV_USE_ARC=n
CONFIG_LV_USE_BAR=n
CONFIG_LV_USE_BUTTON=y
CONFIG_LV_USE_BUTTONMATRIX=y
CONFIG_LV_USE_CALENDAR=n
CONFIG_LV_USE_CANVAS=n
CONFIG_LV_USE_CHART=n
CONFIG_LV_USE_CHECKBOX=n
CONFIG_LV_USE_DROPDOWN=n
CONFIG_LV_USE_IMAGE=n
CONFIG_LV_USE_IMAGEBUTTON=n
CONFIG_LV_USE_KEYBOARD=n
CONFIG_LV_USE_LABEL=y
CONFIG_LV_LABEL_TEXT_SELECTION=n
CONFIG_LV_LABEL_LONG_TXT_HINT=y
CONFIG_LV_LABEL_WAIT_CHAR_COUNT=3
CONFIG_LV_USE_LED=n
CONFIG_LV_USE_LINE=n
CONFIG_LV_USE_LIST=y
CONFIG_LV_USE_MENU=n
CONFIG_LV_USE_MSGBOX=n
CONFIG_LV_USE_ROLLER=n
CONFIG_LV_USE_SCALE=n
CONFIG_LV_USE_SLIDER=n
CONFIG_LV_USE_SPAN=n
CONFIG_LV_USE_SPINBOX=n
CONFIG_LV_USE_SPINNER=n
CONFIG_LV_USE_SWITCH=n
CONFIG_LV_USE_TEXTAREA=n
CONFIG_LV_USE_TABLE=n
CONFIG_LV_USE_TABVIEW=n
CONFIG_LV_USE_TILEVIEW=n
CONFIG_LV_USE_WIN=n
# end of Widget Usage

CONFIG_FATFS_LFN_HEAP=y
```

## esp/components/UI_ili9488/test_apps/sdkconfig.defaults
```kconfig
CONFIG_LV_FONT_MONTSERRAT_14=y
CONFIG_LV_FONT_MONTSERRAT_18=y
CONFIG_LV_FONT_MONTSERRAT_24=y
CONFIG_LV_FONT_MONTSERRAT_48=y
CONFIG_LV_USE_GRIDNAV=y
CONFIG_LV_BUILD_EXAMPLES=n
```

## esp/components/database/Kconfig.projbuild
```kconfig
menu "SD SPI Database Configuration"

	config SD_PIN_MOSI
		int "MOSI GPIO number"
		default 23 if IDF_TARGET_ESP32
		default 35 if IDF_TARGET_ESP32S2
		default 35 if IDF_TARGET_ESP32S3
		default 5  if IDF_TARGET_ESP32H2
		default 20  # C3 and others

	config SD_PIN_MISO
		int "MISO GPIO number"
		default 19 if IDF_TARGET_ESP32
		default 37 if IDF_TARGET_ESP32S2
		default 37 if IDF_TARGET_ESP32S3
		default 0  if IDF_TARGET_ESP32H2
		default 21  # C3 and others

	config SD_PIN_CLK
		int "CLK GPIO number"
		default 18 if IDF_TARGET_ESP32
		default 36 if IDF_TARGET_ESP32S2
		default 36 if IDF_TARGET_ESP32S3
		default 4  if IDF_TARGET_ESP32H2
		default 7  # C3 and others

	config SD_PIN_CS
		int "CS GPIO number"
		default  5 if IDF_TARGET_ESP32
		default 34 if IDF_TARGET_ESP32S2
		default 34 if IDF_TARGET_ESP32S3
		default 9  # C3 and others

    config TEST_SD_CARD
        bool "Test SD Card on boot"
        default n
        help
            DEBUGGING FUNCTION. This will add some more tests to determine if the program can properly read to the SD card.
            Probably useless.

    config CLEAN_DATABASE
        bool "Clear database on boot"
        default n
        help
            DEBUGGING FUNCTION. If enabled, the database is ERASED on boot.
endmenu
```

## esp/components/mqtt_conn/test_apps/main/Kconfig.projbuild
```kconfig
menu "Test App Configuration"
    config DEVICE_ID
       string "The device ID used for various server interactions"
       default "55"
endmenu
```
